## config/west.yml
```yaml
manifest:
  remotes:
    - name: zmkfirmware
      url-base: https://github.com/zmkfirmware
      # Additional modules containing boards/shields/custom code can be listed here as well.
      # See:
      # - https://zmk.dev/docs/features/modules
      # - https://docs.zephyrproject.org/3.5.0/develop/west/manifest.html#projects
    - name: urob
      url-base: https://github.com/urob
      revision: v0.3

  #  - name: gpeye
  #    url-base: https://github.com/GPeye
  projects:
   # - name: mario-peripheral-animation
   #   remote: gpeye
   #    revision: main 
    - name: eyelash_sofle
      url: https://github.com/a741725193/zmk-sofle
      revision: main
    - name: zmk
      remote: zmkfirmware
      revision: v0.3.0
      import: app/west.yml
    - name: zmk-adaptive-key
      remote: urob
      path: modules/zmk/adaptive-key
    - name: zmk-auto-layer
      remote: urob
      path: modules/zmk/auto-layer
    - name: zmk-helpers
      remote: urob
      path: modules/zmk/helpers
    - name: zmk-leader-key
      remote: urob
      path: modules/zmk/leader-key
    - name: zmk-tri-state
      remote: urob
      path: modules/zmk/tri-state
    - name: zmk-unicode
      remote: urob
      path: modules/zmk/unicode
    - name: zmk-helpers
      remote: urob
      revision: v0.3 # Should match ZMK release.

  self:
    path: boards
```
